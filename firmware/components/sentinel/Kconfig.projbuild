## firmware/components/sentinel/Kconfig.projbuild
```kconfig
menu "Sentinel peripherals"
config SENTINEL_SDA
    int "OLED SDA GPIO"
    range 0 48
    default 8
config SENTINEL_SCL
    int "OLED SCL GPIO"
    range 0 48
    default 9
config SENTINEL_OLED_ADDRESS
    hex "SSD1306 I2C address"
    range 0x03 0x77
    default 0x3c
config SENTINEL_BUTTON
    int "External active-low button GPIO"
    range 0 48
    default 4
endmenu

menu "Sentinel optional modules"
config SENTINEL_MODULE_ESCUDO
    bool "Register escudo component (must exist)"
    default n
config SENTINEL_MODULE_SANITIZADOR
    bool "Register sanitizador component (must exist)"
    default n
config SENTINEL_MODULE_CEBO
    bool "Register cebo component (must exist)"
    default n
endmenu
```

## firmware/sdkconfig.defaults
```kconfig
CONFIG_IDF_TARGET="esp32s3"
CONFIG_ESPTOOLPY_FLASHSIZE_16MB=y
CONFIG_ESPTOOLPY_FLASHMODE_QIO=y
CONFIG_SPIRAM=y
CONFIG_SPIRAM_MODE_OCT=y
CONFIG_SPIRAM_SPEED_80M=y
CONFIG_SPIRAM_USE_MALLOC=y
CONFIG_SPIRAM_IGNORE_NOTFOUND=n
CONFIG_BT_ENABLED=y
CONFIG_BT_NIMBLE_ENABLED=y
CONFIG_BT_NIMBLE_ROLE_CENTRAL=n
CONFIG_BT_NIMBLE_ROLE_PERIPHERAL=y
CONFIG_BT_NIMBLE_ROLE_BROADCASTER=y
CONFIG_BT_NIMBLE_ROLE_OBSERVER=n
CONFIG_BT_NIMBLE_MAX_CONNECTIONS=1
CONFIG_BT_NIMBLE_MAX_BONDS=4
CONFIG_BT_NIMBLE_NVS_PERSIST=y
CONFIG_BT_NIMBLE_SM_LEGACY=n
CONFIG_BT_NIMBLE_SM_SC=y
CONFIG_BT_NIMBLE_SM_SC_ONLY=1
CONFIG_BT_NIMBLE_SM_LVL=4
CONFIG_MQTT_PROTOCOL_5=y
CONFIG_MBEDTLS_CERTIFICATE_BUNDLE=n
CONFIG_MBEDTLS_SSL_PROTO_TLS1_2=y
CONFIG_LOG_DEFAULT_LEVEL_WARN=y
CONFIG_COMPILER_CXX_EXCEPTIONS=n
CONFIG_MBEDTLS_HAVE_TIME=y
CONFIG_MBEDTLS_HAVE_TIME_DATE=y
```
